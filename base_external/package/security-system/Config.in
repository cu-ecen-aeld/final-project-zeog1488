## base_external/package/security-system/Config.in
```kconfig
config BR2_PACKAGE_SECURITY_SYSTEM
	bool "security-system"
	help
	  Includes the security system server executable from final-project-source-zeog1488
```
